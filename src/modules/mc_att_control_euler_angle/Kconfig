## src/modules/mc_att_control_euler_angle/Kconfig
```kconfig
menuconfig MODULES_MC_ATT_CONTROL_EULER_ANGLE
	bool "mc_att_control_euler_angle"
	default n
	---help---
		Enable support for mc_att_control_euler_angle

menuconfig USER_MC_ATT_CONTROL_EULER_ANGLE
	bool "mc_att_control_euler_angle running as userspace module"
	default n
	depends on BOARD_PROTECTED && MODULES_MC_ATT_CONTROL_EULER_ANGLE
	---help---
		Put mc_att_control_euler_angle in userspace memory
```

## src/modules/mc_rate_control_ndi/Kconfig
```kconfig
menuconfig MODULES_MC_RATE_CONTROL_NDI
	bool "mc_rate_control_ndi"
	default n
	---help---
		Enable support for mc_rate_control_ndi

menuconfig USER_MC_RATE_CONTROL_NDI
	bool "mc_rate_control_ndi running as userspace module"
	default n
	depends on BOARD_PROTECTED && MODULES_MC_RATE_CONTROL_NDI
	---help---
		Put mc_rate_control_ndi in userspace memory
```

## src/modules/zero_input_plant/Kconfig
```kconfig
menuconfig MODULES_ZERO_INPUT_PLANT
	bool "zero_input_plant"
	default n
	---help---
		Enable support for zero_input_plant

menuconfig USER_ZERO_INPUT_PLANT
	bool "zero_input_plant running as userspace module"
	default n
	depends on BOARD_PROTECTED && MODULES_ZERO_INPUT_PLANT
	---help---
		Put zero_input_plant in userspace memory
```
